// SPDX-License-Identifier: GPL-2.0
/*
 * DT Overlay to limit PCIe0 Root Complex maximum link speed to Gen2.
 *
 * This overlay sets the `max-link-speed` property of the PCIe0 Root
 * Complex to 2 (5.0 GT/s), which can improve compatibility with
 * certain PCIe devices that are unstable at Gen3 speeds.
 *
 * Copyright (C) 2026 T3 Foundation - https://www.t3vakfi.org/
 */

/dts-v1/;
/plugin/;

#include <dt-bindings/gpio/gpio.h>

/*
 * Helper to show loaded overlays under: /proc/device-tree/chosen/overlays/
 */
&{/chosen} {
	overlays {
		k3-am67a-t3-gem-o1-pcie-link-speed-2.kernel = __TIMESTAMP__;
	};
};

&pcie0_rc {
	max-link-speed = <2>;
};
